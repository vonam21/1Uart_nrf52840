## apps/uart_rx/build/Kconfig/Kconfig.shield.defconfig
```kconfig
osource "D:/Desktop/source/uart_tutorial_testing/apps/uart_rx/../..//boards/shields/*/Kconfig.defconfig"
```

## apps/uart_tx/build/Kconfig/Kconfig.modules
```kconfig
menu "acpica (D:/Desktop/source/zephyr_3.4/modules/lib/acpica)"
osource "$(ZEPHYR_ACPICA_KCONFIG)"
config ZEPHYR_ACPICA_MODULE
	bool
	default y
endmenu
menu "canopennode (D:/Desktop/source/zephyr_3.4/modules/lib/canopennode)"
osource "$(ZEPHYR_CANOPENNODE_KCONFIG)"
config ZEPHYR_CANOPENNODE_MODULE
	bool
	default y
endmenu
menu "chre (D:/Desktop/source/zephyr_3.4/modules/lib/chre)"
osource "D:/Desktop/source/zephyr_3.4/modules/lib/chre/platform/zephyr/Kconfig"
config ZEPHYR_CHRE_MODULE
	bool
	default y
endmenu
menu "fatfs (D:/Desktop/source/zephyr_3.4/modules/fs/fatfs)"
osource "$(ZEPHYR_FATFS_KCONFIG)"
config ZEPHYR_FATFS_MODULE
	bool
	default y
endmenu
menu "hal_ambiq (D:/Desktop/source/zephyr_3.4/modules/hal/ambiq)"
osource "$(ZEPHYR_HAL_AMBIQ_KCONFIG)"
config ZEPHYR_HAL_AMBIQ_MODULE
	bool
	default y
endmenu
menu "hal_espressif (D:/Desktop/source/zephyr_3.4/modules/hal/espressif)"
osource "D:/Desktop/source/zephyr_3.4/modules/hal/espressif/zephyr/Kconfig"
config ZEPHYR_HAL_ESPRESSIF_MODULE
	bool
	default y
endmenu
menu "hal_ethos_u (D:/Desktop/source/zephyr_3.4/modules/hal/ethos_u)"
osource "$(ZEPHYR_HAL_ETHOS_U_KCONFIG)"
config ZEPHYR_HAL_ETHOS_U_MODULE
	bool
	default y
endmenu
menu "hal_gigadevice (D:/Desktop/source/zephyr_3.4/modules/hal/gigadevice)"
osource "$(ZEPHYR_HAL_GIGADEVICE_KCONFIG)"
config ZEPHYR_HAL_GIGADEVICE_MODULE
	bool
	default y
endmenu
menu "hal_infineon (D:/Desktop/source/zephyr_3.4/modules/hal/infineon)"
osource "$(ZEPHYR_HAL_INFINEON_KCONFIG)"
config ZEPHYR_HAL_INFINEON_MODULE
	bool
	default y
endmenu
menu "hal_nordic (D:/Desktop/source/zephyr_3.4/modules/hal/nordic)"
osource "$(ZEPHYR_HAL_NORDIC_KCONFIG)"
config ZEPHYR_HAL_NORDIC_MODULE
	bool
	default y
endmenu
menu "hal_nxp (D:/Desktop/source/zephyr_3.4/modules/hal/nxp)"
osource "$(ZEPHYR_HAL_NXP_KCONFIG)"
config ZEPHYR_HAL_NXP_MODULE
	bool
	default y
endmenu
menu "hal_rpi_pico (D:/Desktop/source/zephyr_3.4/modules/hal/rpi_pico)"
osource "$(ZEPHYR_HAL_RPI_PICO_KCONFIG)"
config ZEPHYR_HAL_RPI_PICO_MODULE
	bool
	default y
endmenu
menu "silabs (D:/Desktop/source/zephyr_3.4/modules/hal/silabs)"
osource "D:/Desktop/source/zephyr_3.4/modules/hal/silabs/zephyr/Kconfig"
config ZEPHYR_SILABS_MODULE
	bool
	default y
endmenu
menu "hal_telink (D:/Desktop/source/zephyr_3.4/modules/hal/telink)"
osource "D:/Desktop/source/zephyr_3.4/modules/hal/telink/Kconfig"
config ZEPHYR_HAL_TELINK_MODULE
	bool
	default y
endmenu
menu "liblc3 (D:/Desktop/source/zephyr_3.4/modules/lib/liblc3)"
osource "$(ZEPHYR_LIBLC3_KCONFIG)"
config ZEPHYR_LIBLC3_MODULE
	bool
	default y
endmenu
menu "littlefs (D:/Desktop/source/zephyr_3.4/modules/fs/littlefs)"
osource "$(ZEPHYR_LITTLEFS_KCONFIG)"
config ZEPHYR_LITTLEFS_MODULE
	bool
	default y
endmenu
menu "loramac-node (D:/Desktop/source/zephyr_3.4/modules/lib/loramac-node)"
osource "$(ZEPHYR_LORAMAC_NODE_KCONFIG)"
config ZEPHYR_LORAMAC_NODE_MODULE
	bool
	default y
endmenu
menu "lvgl (D:/Desktop/source/zephyr_3.4/modules/lib/gui/lvgl)"
osource "D:/Desktop/source/zephyr_3.4/modules/lib/gui/lvgl/Kconfig"
config ZEPHYR_LVGL_MODULE
	bool
	default y
endmenu
menu "lz4 (D:/Desktop/source/zephyr_3.4/modules/lib/lz4)"
osource "$(ZEPHYR_LZ4_KCONFIG)"
config ZEPHYR_LZ4_MODULE
	bool
	default y
endmenu
menu "mbedtls (D:/Desktop/source/zephyr_3.4/modules/crypto/mbedtls)"
osource "$(ZEPHYR_MBEDTLS_KCONFIG)"
config ZEPHYR_MBEDTLS_MODULE
	bool
	default y
endmenu
menu "nanopb (D:/Desktop/source/zephyr_3.4/modules/lib/nanopb)"
osource "$(ZEPHYR_NANOPB_KCONFIG)"
config ZEPHYR_NANOPB_MODULE
	bool
	default y
endmenu
menu "openthread (D:/Desktop/source/zephyr_3.4/modules/lib/openthread)"
osource "$(ZEPHYR_OPENTHREAD_KCONFIG)"
config ZEPHYR_OPENTHREAD_MODULE
	bool
	default y
endmenu
menu "picolibc (D:/Desktop/source/zephyr_3.4/modules/lib/picolibc)"
osource "D:/Desktop/source/zephyr_3.4/modules/lib/picolibc/zephyr/Kconfig"
config ZEPHYR_PICOLIBC_MODULE
	bool
	default y
endmenu
menu "segger (D:/Desktop/source/zephyr_3.4/modules/debug/segger)"
osource "$(ZEPHYR_SEGGER_KCONFIG)"
config ZEPHYR_SEGGER_MODULE
	bool
	default y
endmenu
menu "sof (D:/Desktop/source/zephyr_3.4/modules/audio/sof)"
osource "D:/Desktop/source/zephyr_3.4/modules/audio/sof/zephyr/Kconfig"
config ZEPHYR_SOF_MODULE
	bool
	default y
endmenu
menu "tflite-micro (D:/Desktop/source/zephyr_3.4/modules/lib/tflite-micro)"
osource "$(ZEPHYR_TFLITE_MICRO_KCONFIG)"
config ZEPHYR_TFLITE_MICRO_MODULE
	bool
	default y
endmenu
menu "TraceRecorder (D:/Desktop/source/zephyr_3.4/modules/debug/TraceRecorder)"
osource "D:/Desktop/source/zephyr_3.4/modules/debug/TraceRecorder/kernelports/Zephyr/Kconfig"
config ZEPHYR_TRACERECORDER_MODULE
	bool
	default y
endmenu
menu "trusted-firmware-m (D:/Desktop/source/zephyr_3.4/modules/tee/tf-m/trusted-firmware-m)"
osource "$(ZEPHYR_TRUSTED_FIRMWARE_M_KCONFIG)"
config ZEPHYR_TRUSTED_FIRMWARE_M_MODULE
	bool
	default y
endmenu
menu "trusted-firmware-a (D:/Desktop/source/zephyr_3.4/modules/tee/tf-a/trusted-firmware-a)"
osource "$(ZEPHYR_TRUSTED_FIRMWARE_A_KCONFIG)"
config ZEPHYR_TRUSTED_FIRMWARE_A_MODULE
	bool
	default y
endmenu
menu "uoscore-uedhoc (D:/Desktop/source/zephyr_3.4/modules/lib/uoscore-uedhoc)"
osource "$(ZEPHYR_UOSCORE_UEDHOC_KCONFIG)"
config ZEPHYR_UOSCORE_UEDHOC_MODULE
	bool
	default y
endmenu
menu "zcbor (D:/Desktop/source/zephyr_3.4/modules/lib/zcbor)"
osource "$(ZEPHYR_ZCBOR_KCONFIG)"
config ZEPHYR_ZCBOR_MODULE
	bool
	default y
endmenu
menu "zscilib (D:/Desktop/source/zephyr_3.4/modules/lib/zscilib)"
osource "D:/Desktop/source/zephyr_3.4/modules/lib/zscilib/Kconfig.zscilib"
config ZEPHYR_ZSCILIB_MODULE
	bool
	default y
endmenu
menu "thrift (D:/Desktop/source/zephyr_3.4/modules/lib/thrift)"
osource "$(ZEPHYR_THRIFT_KCONFIG)"
config ZEPHYR_THRIFT_MODULE
	bool
	default y
endmenu
```

## apps/uart_tx/build/Kconfig/Kconfig.shield.defconfig
```kconfig
osource "D:/Desktop/source/uart_tutorial_testing/apps/uart_tx/../..//boards/shields/*/Kconfig.defconfig"
```

## boards/arm/blue_pill/Kconfig.board
```kconfig
# Copyright (c) 2023 Quasal
# SPDX-License-Identifier: Apache-2.0

config BOARD_STM32F1
    bool "blue_pill"
    depends on SOC_STM32F103XE
```

## boards/arm/blue_pill/Kconfig.defconfig
```kconfig
# Copyright (c) 2023 Quasal
# SPDX-License-Identifier: Apache-2.0

if BOARD_STM32F1

config BOARD
    default "blue_pill"

endif # BOARD_STM32F1
```

## boards/arm/blue_pill/blue_pill_defconfig
```kconfig
# SPDX-License-Identifier: Apache-2.0

CONFIG_SOC_SERIES_STM32F1X=y
CONFIG_SOC_STM32F103XE=y

# enable pin controller
CONFIG_PINCTRL=y

# enable GPIO
CONFIG_GPIO=y

# enable RCC clock control
CONFIG_CLOCK_CONTROL=y

# enable console
CONFIG_LOG=y
CONFIG_CONSOLE=y

CONFIG_RTT_CONSOLE=y
CONFIG_USE_SEGGER_RTT=y
CONFIG_LOG_BACKEND_RTT=y

CONFIG_SERIAL=y
CONFIG_UART_INTERRUPT_DRIVEN=y
```

## boards/arm/nrf/Kconfig.board
```kconfig
    # Copyright (c) 2023 Quasal
# SPDX-License-Identifier: Apache-2.0

config BOARD_STM32F4
    bool "nrf"
    depends on SOC_NRF52811_QFAA
```

## boards/arm/nrf/nrf_defconfig
```kconfig
# SPDX-License-Identifier: Apache-2.0

CONFIG_SOC_SERIES_NRF52X=y
CONFIG_SOC_NRF52811_QFAA=y

# Enable MPU
CONFIG_ARM_MPU=y

# Enable hardware stack protection
CONFIG_HW_STACK_PROTECTION=y

# enable pin controller
CONFIG_PINCTRL=y

# enable GPIO
CONFIG_GPIO=y

# enable RCC clock control
CONFIG_CLOCK_CONTROL_NRF=y
CONFIG_CLOCK_CONTROL_NRF_K32SRC_RC=y
# additional board options
CONFIG_GPIO_AS_PINRESET=y
CONFIG_LOG=y
CONFIG_CONSOLE=y

CONFIG_RTT_CONSOLE=y
CONFIG_USE_SEGGER_RTT=y
CONFIG_LOG_BACKEND_RTT=y
```

## boards/arm/stm32f4/Kconfig.board
```kconfig
# Copyright (c) 2023 Quasal
# SPDX-License-Identifier: Apache-2.0

config BOARD_STM32F4
    bool "stm32f4"
    depends on SOC_STM32F411XE
```

## boards/arm/stm32f4/Kconfig.defconfig
```kconfig
# Copyright (c) 2023 Quasal
# SPDX-License-Identifier: Apache-2.0

if BOARD_STM32F4

config BOARD
    default "stm32f4"

endif # BOARD_STM32F4
```

## boards/arm/stm32f4/stm32f4_defconfig
```kconfig
# SPDX-License-Identifier: Apache-2.0

CONFIG_SOC_SERIES_STM32F4X=y
CONFIG_SOC_STM32F411XE=y

# enable pin controller
CONFIG_PINCTRL=y

# enable GPIO
CONFIG_GPIO=y

# enable RCC clock control
CONFIG_CLOCK_CONTROL=y

CONFIG_LOG=y
CONFIG_CONSOLE=y
CONFIG_UART_CONSOLE=y
CONFIG_RTT_CONSOLE=n
CONFIG_USE_SEGGER_RTT=n
CONFIG_LOG_BACKEND_RTT=n

CONFIG_SERIAL=y
CONFIG_UART_INTERRUPT_DRIVEN=y
CONFIG_ENTROPY_DEVICE_RANDOM_GENERATOR=y
```
